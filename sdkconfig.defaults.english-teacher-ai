## sdkconfig.defaults.english-teacher-ai
```kconfig
CONFIG_BOARD_TYPE_ENGLISH_TEACHER_AI=y
CONFIG_ESPTOOLPY_FLASHSIZE_16MB=y
CONFIG_PARTITION_TABLE_CUSTOM_FILENAME="partitions/v2/16m.csv"
CONFIG_ESP_CONSOLE_USB_SERIAL_JTAG=y
CONFIG_LANGUAGE_EN_US=y
CONFIG_USE_WECHAT_MESSAGE_STYLE=y
```
